/*
 * Copyright (C) 2018 MediaTek Inc.
 *
 * This program is free software; you can redistribute it and/or modify
 * it under the terms of the GNU General Public License version 2 as
 * published by the Free Software Foundation.
 *
 * This program is distributed in the hope that it will be useful,
 * but WITHOUT ANY WARRANTY; without even the implied warranty of
 * MERCHANTABILITY or FITNESS FOR A PARTICULAR PURPOSE.
 * See http://www.gnu.org/licenses/gpl-2.0.html for more details.
 */
bat_gm30: battery{
	compatible = "mediatek,bat_gm30";
	DIFFERENCE_FULLOCV_ITH = <(250)>;
/*	Charging termination current*/
//#ifdef VENDOR_EDIT
/*lizhijie@BSP.CHG.Basic 2020/04/07 lzj add for fg*/
	SHUTDOWN_1_TIME = <(30)>;
//#else
//	SHUTDOWN_1_TIME = <(5)>;
//#endif
/*	If ui_soc shows 1% more than X minites, system will shutdown*/
	KEEP_100_PERCENT = <(5)>;
/*	The ui_soc will keep 100% until SOC drop X percents after unplugged*/
	R_FG_VALUE = <(10)>;
/*	R_sense resistance*/
	EMBEDDED_SEL = <(0)>;
/*	Configures whether using embedded battery or not*/
	PMIC_SHUTDOWN_CURRENT = <(20)>;
/*	System shutdown current*/
//#ifdef VENDOR_EDIT
/*lizhijie@BSP.CHG.Basic 2020/04/07 lzj add for fg*/
//	FG_METER_RESISTANCE = <(100)>;
//#else
	FG_METER_RESISTANCE = <(60)>;
//#endif
/*	The resistance of PCB*/
	CAR_TUNE_VALUE = <(97)>;
/*	Tune value for current measurement*/
	PMIC_MIN_VOL = <(33500)>;
/*	vboot voltage for gauge 0%*/
	POWERON_SYSTEM_IBOOT = <(500)>;
/*	power on system iboot*/
	SHUTDOWN_GAUGE0_VOLTAGE = <(34000)>;
/*	shutdown gauge 0% voltage*/
	TEMPERATURE_T0 = <(50)>;
/*	Battery temperature T0*/
	TEMPERATURE_T1 = <(25)>;
/*	Battery temperature T1*/
	TEMPERATURE_T2 = <(10)>;
/*	Battery temperature T2*/
	TEMPERATURE_T3 = <(0)>;
/*	Battery temperature T3*/
//#ifndef VENDOR_EDIT
/*lizhijie@BSP.CHG.Basic 2020/04/07 lzj add for fg*/
//	TEMPERATURE_T4 = <(-6)>;
//#else
	TEMPERATURE_T4 = <(-10)>;
//#endif
/*	Battery temperature T4*/
//#ifndef VENDOR_EDIT
/*lizhijie@BSP.CHG.Basic 2020/04/07 lzj add for fg*/
//	TEMPERATURE_T5 = <(-10)>;
/*	Battery temperature T5*/
//#endif
//#ifndef VENDOR_EDIT
/*lizhijie@BSP.CHG.Basic 2020/04/17 lzj add for fg*/
//	g_FG_PSEUDO100_T0 = <(100)>;
/*	Pseudo 100% percentage at T0*/
//	g_FG_PSEUDO100_T1 = <(100)>;
/*	Pseudo 100% percentage at T1*/
//	g_FG_PSEUDO100_T2 = <(100)>;
/*	Pseudo 100% percentage at T2*/
//	g_FG_PSEUDO100_T3 = <(100)>;
/*	Pseudo 100% percentage at T3*/
//	g_FG_PSEUDO100_T4 = <(100)>;
//#else
	g_FG_PSEUDO100_T0 = <(98)>;
/*	Pseudo 100% percentage at T0*/
	g_FG_PSEUDO100_T1 = <(98)>;
/*	Pseudo 100% percentage at T1*/
	g_FG_PSEUDO100_T2 = <(102)>;
/*	Pseudo 100% percentage at T2*/
	g_FG_PSEUDO100_T3 = <(102)>;
/*	Pseudo 100% percentage at T3*/
	g_FG_PSEUDO100_T4 = <(102)>;	
//#endif
/*	Pseudo 100% percentage at T4*/
	Q_MAX_SYS_VOLTAGE_BAT0 = <(3350)>;
/*	Pseudo1 for hide percentage*/
	Q_MAX_SYS_VOLTAGE_BAT1 = <(3350)>;
/*	Pseudo1 for hide percentage*/
	Q_MAX_SYS_VOLTAGE_BAT2 = <(3350)>;
/*	Pseudo1 for hide percentage*/
	Q_MAX_SYS_VOLTAGE_BAT3 = <(3350)>;
/*	Pseudo1 for hide percentage*/
//#ifndef VENDOR_EDIT
/*lizhijie@BSP.CHG.Basic 2020/04/17 lzj add for fg*/
//	COM_FG_METER_RESISTANCE = <(100)>;
//#else
	COM_FG_METER_RESISTANCE = <(60)>;
//#endif
/*	compensate The resistance of PCB*/
	COM_R_FG_VALUE = <(0)>;
/*	compensate R_sense resistance*/
	enable_tmp_intr_suspend = <(0)>;
/* Enable update temp when suspend */
//#ifndef VENDOR_EDIT
/*lizhijie@BSP.CHG.Basic 2020/04/07 lzj add for fg*/
//	ACTIVE_TABLE = <(6)>;
//#else
	ACTIVE_TABLE = <(5)>;
//#endif
/* Table numbers per battery*/
	MULTI_TEMP_GAUGE0 = <(1)>;
/* Multi gauge0 enable*/
#include "mt6779_battery_table_ext.dtsi"
//#ifdef VENDOR_EDIT
/*lizhijie@BSP.CHG.Basic 2020/04/17 lzj add for fg*/
	#include "mt6779_battery_prop_dim2_ext.dtsi"
//#endif
};
